## prototipo/demos/blink_led_demo/zephyr/build/Kconfig/boards/Kconfig
```kconfig
# Load Zephyr board Kconfig descriptions.
osource "C:/Users/fyaih/programacao/zephyr_ws/zephyrproject/zephyr/boards/weact/blackpill_f411ce/Kconfig"
```
